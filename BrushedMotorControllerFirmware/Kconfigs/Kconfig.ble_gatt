## BrushedMotorControllerFirmware/Kconfigs/Kconfig.ble_gatt
```kconfig
menu "Bluetooth Configuration"

config BT_SUPPORT
	bool "bool value, 1 if BLE is supposed to be supported, 0 if not"
	select BT
	select BT_SMP
	select BT_PERIPHERAL
	select BT_DIS
	select BT_DIS_PNP
	default y

config BT_DEVICE_NAME
	string "BLE device name"
	default "Motor Controller"
	depends on BT_SUPPORT

config BT_DEVICE_APPEARANCE
	default 833
	depends on BT_SUPPORT

endmenu
```

## BrushedMotorControllerFirmware/Kconfigs/Kconfig.motor
```kconfig
menu "Motor Configuration"

config GEARSHIFT_RATIO
	int "Gearshift ratio of attached motor"
	default 150

config ENC_STEPS_PER_ROTATION
	int "Number of encoder steps per one full rotation"
	default 64

config SPEED_MAX_MRPM
	int "Max motor speed from motor documentation (in mili RPM - one thousands of RPM)"
	default 67000

config MIN_SPEED_MODIFIER
	int "divider for minimal speed. \
	     Max speed is taken and divied by this value \
	     used as minimum RPM value that can be set, RPMs lower than that will be treated as \
	     zero. Also, it is used as minimum speed during position control."
	default 28

endmenu
```

## BrushedMotorControllerFirmware/Kconfigs/Kconfig.position_cntrl
```kconfig
menu "Position Control Configuration"

config POS_CONTROL_ENABLE
	bool "Enable functions responsible for position control, like mode position, \
	     pos set, etc.. Continuus calculation of position and pos read is always \
	     enabled."
	default y

config KP_NUMERATOR_FOR_SPEED_IN_POS
	int "proportional part numerator for setting speed during position control"
	default 4
	depends on POS_CONTROL_ENABLE

config KP_DENOMINATOR_FOR_SPEED_IN_POS
	int "proportional part denominator for setting speed during position control"
	default 50
	depends on POS_CONTROL_ENABLE

config KP_NUMERATOR_FOR_POS
	int "proportional part numerator for setting speed during position control"
	default 2
	depends on POS_CONTROL_ENABLE

config KP_DENOMINATOR_FOR_POS
	int "proportional part denominator for setting speed during position control"
	default 1
	depends on POS_CONTROL_ENABLE

config POSITION_CONTROL_MODIFIER
	int "Accuracy of position control (if value is 10 position is controlled in deca-degrees; \
	     if 100 - centi-degrees etc.)"
	default 100
	depends on POS_CONTROL_ENABLE

config POS_CONTROL_PRECISION_MODIFIER
	int "divider for precision of position control.\
	     Ex. 720 means that precision is 360/720 = +-0.5 degree"
	default 720
	depends on POS_CONTROL_ENABLE

config POS_CONTROL_HISTERESIS_PERCENTAGE
	int "Histeresis percentage of position control. For no histeresis, set to 100."
	default 100
	depends on POS_CONTROL_ENABLE

config POS_SOFT_START
	bool "Speed during position control will incrementally start from zero. If false,\
	will immediately start from given speed."
	default y
	depends on POS_CONTROL_ENABLE
endmenu
```

## BrushedMotorControllerFirmware/Kconfigs/Kconfig.serial_shell
```kconfig
menu "Serial Shell Configuration"

config UART_SHELL_SUPPORT
	bool "Support for communication using uart shell - set to one to communicate via shell \
	      over uart, 0 for disabled communication"
	default y

config USB_DEVICE_VID
	default 0x1915
	depends on UART_SHELL_SUPPORT

config USB_DEVICE_PID
	default 0x0000
	depends on UART_SHELL_SUPPORT
endmenu
```

## BrushedMotorControllerFirmware/Kconfigs/Kconfig.speed_cntrl
```kconfig
menu "Speed Control Configuration"

config SPEED_CONTROL_ENABLE
	bool "Enable functions responsible for speed control, like mode speed, \
	     speed set, etc."
	default y

if SPEED_CONTROL_ENABLE
config KP_NUMERATOR_FOR_SPEED
	int "proportional part numerator for speed control"
	default 4

config KP_DENOMINATOR_FOR_SPEED
	int "proportional part denominator for speed control"
	default 10
endif

endmenu
```

## BrushedMotorControllerFirmware/Kconfigs/Kconfig.templates
```kconfig
menu "Templates Configuration"

config TEMPLATES_ENABLE
	bool "Enable usage of template storage"
	default y
	depends on SPEED_CONTROL_ENABLE #TODO - Templates should be configurable and independent of SPEED/POS!

config TEMPLATE_NAME_SIZE
	int "Max size of template's name in characters"
	default 12

endmenu
```
